## CMakeLists.txt
```
cmake_minimum_required(VERSION 3.13.1)

if(NOT DEFINED BOARD)
  set(BOARD nrf9160_pca20035ns)
endif()

#Include nrf boilerplate
get_filename_component(NRF_BASE $ENV{ZEPHYR_BASE}/../nrf ABSOLUTE)
include(${NRF_BASE}/cmake/boilerplate.cmake)

include($ENV{ZEPHYR_BASE}/cmake/app/boilerplate.cmake NO_POLICY_SCOPE)
project(telenor_fota)

target_sources(app PRIVATE src/main.c)
target_sources(app PRIVATE src/coap.c)
zephyr_include_directories(src)
```

## prj.conf
```kconfig
# General config
CONFIG_ASSERT=y

# Logging
CONFIG_LOG=y
CONFIG_LOG_STRDUP_MAX_STRING=64

# Network
CONFIG_NETWORKING=y
CONFIG_NET_SOCKETS=y
CONFIG_NET_SOCKETS_OFFLOAD=y

# BSD library
CONFIG_BSD_LIBRARY=y

# LTE link control
CONFIG_LTE_LINK_CONTROL=y
CONFIG_LTE_AUTO_INIT_AND_CONNECT=y
CONFIG_LTE_PDP_CMD=y
CONFIG_LTE_PDP_CONTEXT="0,\"IP\",\"telenor.iotgw\""

# CoAP
CONFIG_COAP=y

# Heap and stacks
CONFIG_HEAP_MEM_POOL_SIZE=16384
CONFIG_MAIN_STACK_SIZE=8192
CONFIG_SYSTEM_WORKQUEUE_STACK_SIZE=2048
CONFIG_HW_STACK_PROTECTION=y

# Disable native network stack to save some memory
CONFIG_NET_IPV4=n
CONFIG_NET_IPV6=n
CONFIG_NET_UDP=n
CONFIG_NET_TCP=n
CONFIG_NET_RX_STACK_SIZE=1024
CONFIG_NET_TX_STACK_SIZE=1024

# Uncomment the lines below to disable optimizations when debugging
# CONFIG_NO_OPTIMIZATIONS=y
# CONFIG_DEBUG=y
```

## src/main.c
```c
#include <zephyr.h>
#include <logging/log.h>

#include "coap.h"

LOG_MODULE_REGISTER(app_main, CONFIG_APP_LOG_LEVEL);

static int message_post(struct coap_resource *resource, struct coap_packet *request, struct sockaddr *addr, socklen_t addr_len) {
	coap_endpoint *coap = resource->user_data;

	u16_t payload_len;
	const u8_t *payload = coap_packet_get_payload(request, &payload_len);

	u8_t *buf = k_calloc(payload_len + 1, 1);
	memcpy(buf, payload, payload_len);
	LOG_INF("Received CoAP POST: %s", log_strdup(buf));
	k_free(buf);

	int err = coap_endpoint_respond(coap, request, COAP_RESPONSE_CODE_CREATED, NULL, 0, addr, addr_len);
	if (err != 0) {
		LOG_ERR("coap_endpoint_respond: %d", err);
	}

	return 0;
}

static const char * const message_path[] = { "message", NULL };
static struct coap_resource resources[] = {
	{
		path: message_path,
		post: message_post,
	},
	{},
};

void main() {
	LOG_INF("CoAP sample application started");

	struct sockaddr_in local_addr = {
		.sin_family = AF_INET,
		.sin_port = htons(5683),
	};
	coap_endpoint *coap = coap_endpoint_init((struct sockaddr *)&local_addr, sizeof(local_addr), resources);
	if (coap == NULL) {
		LOG_ERR("coap_endpoint_init");
		return;
	}
	resources[0].user_data = coap;

	struct sockaddr_in remote_addr = {
		.sin_family = AF_INET,
		.sin_port = htons(5683),
	};
	net_addr_pton(AF_INET, "172.32.16.1", &remote_addr.sin_addr);
	u8_t *msg = "Wallah dette er helt sykt, shamener?";
	const char * const path[] = { "straight", "and", "narrow", NULL };
	int ret = coap_endpoint_post(coap, (struct sockaddr *)&remote_addr, sizeof(remote_addr), path, msg, strlen(msg));
	if (ret != COAP_RESPONSE_CODE_CREATED) {
		LOG_ERR("coap_endpoint_post: %d", ret);
		return;
	}
	
	LOG_INF("Sent Coap POST");
}
```
